## drivers/display/Kconfig.rm69310
```kconfig
# RM69310 display controller configuration options
# Copyright (c) 2025 Lenovo Japan
# SPDX-License-Identifier: Apache-2.0

menuconfig RM69310
	bool "RM69310 display controller driver"
	default y
	depends on DT_HAS_LENOVO_RM69310_ENABLED
	select MIPI_DBI
	help
	  Enable driver for RM69310 display controller.

if RM69310

config RM69310_DEFAULT_BRIGHTNESS
	int "RM69310 default brightness"
	default 200
	range 0 255
	help
	  RM69310 default brightness.

endif # RM69310
```
